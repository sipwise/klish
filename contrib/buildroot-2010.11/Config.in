## contrib/buildroot-2010.11/Config.in
```kconfig
config BR2_PACKAGE_KLISH
	bool "klish"
	help
	  The klish is a framework for implementing a CISCO-like CLI on a UNIX systems.
	  It is configurable by XML files. The klish is the fork of clish project.

	  http://klish.googlecode.com

if BR2_PACKAGE_KLISH

config BR2_PACKAGE_KLISH_SVN
	bool "Get klish sources from the SVN repository"
	help
	  Use source code from SVN repository instead klish stable version.

endif
```

## contrib/buildroot-2014.08/Config.in
```kconfig
menuconfig BR2_PACKAGE_KLISH
	bool "klish"
	depends on BR2_PACKAGE_LIBROXML || BR2_PACKAGE_LIBXML2 || BR2_PACKAGE_EXPAT
	help
	  The klish is a framework for implementing a CISCO-like CLI on a UNIX systems.
	  It is configurable by XML files.

	  http://klish.libcode.org
```
